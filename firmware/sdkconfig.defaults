## firmware/sdkconfig.defaults
```kconfig
# PulseScope ESP32-S3 Default Configuration

# Target
CONFIG_IDF_TARGET_ESP32S3=y

# Application manager
CONFIG_APP_PROJECT_VER_FROM_CONFIG=y
CONFIG_APP_PROJECT_VER="1.0.0"

# Serial flasher config
CONFIG_ESPTOOLPY_FLASHSIZE_8MB=y
CONFIG_ESPTOOLPY_FLASHSIZE=0x800000
CONFIG_ESPTOOLPY_FLASHMODE_QIO=y
CONFIG_ESPTOOLPY_FLASHFREQ_80M=y

# Partition table
CONFIG_PARTITION_TABLE_CUSTOM=y
CONFIG_PARTITION_TABLE_CUSTOM_FILENAME="partitions.csv"
CONFIG_PARTITION_TABLE_MD5=y

# FreeRTOS
CONFIG_FREERTOS_HZ=1000
CONFIG_FREERTOS_CHECK_STACKOVERFLOW_CANARY=y
CONFIG_FREERTOS_USE_TRACE_FACILITY=y
CONFIG_FREERTOS_TASK_FUNCTIONS_IDLE_TASK_STACKSIZE=2048

# Heap
CONFIG_HEAP_POISONING_LIGHT=y
CONFIG_HEAP_TRACING_DEST_NONE=y

# Log
CONFIG_LOG_DEFAULT_LEVEL_INFO=y
CONFIG_LOG_MAXIMUM_LEVEL_VERBOSE=y

# Driver
CONFIG_GDMA_CTRL_FUNC_IN_IRAM=y

# I2S
CONFIG_I2S_ENABLE_DEBUG_LOG=n
CONFIG_I2S_ISR_IRAM_SAFE=y

# TinyUSB
CONFIG_TINYUSB=y
CONFIG_TINYUSB_CDC_ACM_ENABLED=y
CONFIG_TINYUSB_CDC_ACM_COUNT=1
CONFIG_TINYUSB_CDC_RX_BUFSIZE=2048
CONFIG_TINYUSB_CDC_TX_BUFSIZE=2048

# LWIP (not used, but needed for some configs)
CONFIG_LWIP_ENABLE=n

# Performance
CONFIG_COMPILER_OPTIMIZATION_PERF=y
CONFIG_COMPILER_OPTIMIZATION_ASSERTIONS_DISABLE=y
CONFIG_COMPILER_OPTIMIZATION_SIZE=n

# Watchdog
CONFIG_ESP_TASK_WDT=y
CONFIG_ESP_TASK_WDT_TIMEOUT_S=30
CONFIG_ESP_TASK_WDT_CHECK_IDLE_TASK_CPU0=y
CONFIG_ESP_TASK_WDT_CHECK_IDLE_TASK_CPU1=y
CONFIG_ESP_INT_WDT=y
CONFIG_ESP_INT_WDT_TIMEOUT_MS=500
```
